## boards/arm/fanstel_bm832/Kconfig.board
```kconfig
# Copyright (c) 2021 Nordic Semiconductor ASA
# SPDX-License-Identifier: Apache-2.0

config BOARD_FANSTEL_BM832
	bool "Fanstel BM832"
	depends on SOC_NRF52832_CIAA
```

## boards/arm/fanstel_bm832/Kconfig.defconfig
```kconfig
# Copyright (c) 2021 Nordic Semiconductor ASA
# SPDX-License-Identifier: Apache-2.0

if BOARD_FANSTEL_BM832

config BOARD
	default "fanstel_bm832"

endif # BOARD_FANSTEL_BM832
```
