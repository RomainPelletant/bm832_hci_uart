/*
 * Copyright (c) 2021 Nordic Semiconductor ASA
 * SPDX-License-Identifier: Apache-2.0
 */

/dts-v1/;
#include <nordic/nrf52832_ciaa.dtsi>
#include "fanstel_bm832-pinctrl.dtsi"

/ {
	model = "Fanstel BM832 Board";
	compatible = "fanstel,bm832";

	chosen {
		zephyr,sram = &sram0;
		zephyr,flash = &flash0;
		zephyr,bt_c2h_uart = &uart0;
	};
};

&gpio0 {
	status = "okay";
};

&uart0 {
	compatible = "nordic,nrf-uart";
	status = "okay";

	current-speed = <921600>;
	pinctrl-0 = <&uart0_default>;
	pinctrl-1 = <&uart0_sleep>;
	pinctrl-names = "default", "sleep";
	hw-flow-control;
};
